## arch/arm/mach-omap2/Kconfig
```kconfig
if ARCH_OMAP2PLUS

menu "TI OMAP2/3/4 Specific Features"

config ARCH_OMAP2PLUS_TYPICAL
	bool "Typical OMAP configuration"
	default y
	select AEABI
	select REGULATOR
	select PM
	select PM_RUNTIME
	select VFP
	select NEON if ARCH_OMAP3 || ARCH_OMAP4
	select SERIAL_OMAP
	select SERIAL_OMAP_CONSOLE
	select I2C
	select I2C_OMAP
	select MFD_SUPPORT
	select MENELAUS if ARCH_OMAP2
	select TWL4030_CORE if ARCH_OMAP3 || ARCH_OMAP4
	select TWL4030_POWER if ARCH_OMAP3 || ARCH_OMAP4
	help
	  Compile a kernel suitable for booting most boards

config ARCH_OMAP2
	bool "TI OMAP2"
	depends on ARCH_OMAP2PLUS
	default y
	select CPU_V6

config ARCH_OMAP3
	bool "TI OMAP3"
	depends on ARCH_OMAP2PLUS
	default y
	select CPU_V7
	select USB_ARCH_HAS_EHCI
	select ARM_L1_CACHE_SHIFT_6 if !ARCH_OMAP4
	select ARCH_HAS_OPP
	select PM_OPP if PM

config ARCH_OMAP4
	bool "TI OMAP4"
	default y
	depends on ARCH_OMAP2PLUS
	select CPU_V7
	select ARM_GIC
	select LOCAL_TIMERS if SMP
	select PL310_ERRATA_769419 if CONFIG_CACHE_L2X0
	select ARM_ERRATA_754322
	select ARCH_HAS_OPP
	select PM_OPP if PM
	select USB_ARCH_HAS_EHCI
	select ARCH_HAS_BARRIERS

comment "OMAP Core Type"
	depends on ARCH_OMAP2

config SOC_OMAP2420
	bool "OMAP2420 support"
	depends on ARCH_OMAP2
	default y
	select OMAP_DM_TIMER
	select ARCH_OMAP_OTG

config SOC_OMAP2430
	bool "OMAP2430 support"
	depends on ARCH_OMAP2
	default y
	select ARCH_OMAP_OTG

config SOC_OMAP3430
	bool "OMAP3430 support"
	depends on ARCH_OMAP3
	default y
	select ARCH_OMAP_OTG

config SOC_OMAPTI816X
	bool "TI816X support"
	depends on ARCH_OMAP3
	default y

config OMAP_PACKAGE_ZAF
       bool

config OMAP_PACKAGE_ZAC
       bool

config OMAP_PACKAGE_CBC
       bool

config OMAP_PACKAGE_CBB
       bool

config OMAP_PACKAGE_CUS
       bool

config OMAP_PACKAGE_CBP
       bool

config OMAP_PACKAGE_CBL
       bool

config OMAP_PACKAGE_CBS
       bool

comment "OMAP Board Type"
	depends on ARCH_OMAP2PLUS

config MACH_OMAP_GENERIC
	bool "Generic OMAP board"
	depends on ARCH_OMAP2
	default y

config MACH_OMAP2_TUSB6010
	bool
	depends on ARCH_OMAP2 && SOC_OMAP2420
	default y if MACH_NOKIA_N8X0

config MACH_TUNA
	bool "Tuna Board"
	default y
	depends on ARCH_OMAP4
	select OMAP_PACKAGE_CBL
	select OMAP_PACKAGE_CBS
	select REGULATOR_FIXED_VOLTAGE
	select OMAP_TPS6236X
	select OMAP_RAM_CONSOLE

config OMAP3_EMU
	bool "OMAP3 debugging peripherals"
	depends on ARCH_OMAP3
	select ARM_AMBA
	select OC_ETM
	help
	  Say Y here to enable debugging hardware of omap3

config OMAP3_SDRC_AC_TIMING
	bool "Enable SDRC AC timing register changes"
	depends on ARCH_OMAP3
	default n
	help
	  If you know that none of your system initiators will attempt to
	  access SDRAM during CORE DVFS, select Y here.  This should boost
	  SDRAM performance at lower CORE OPPs.  There are relatively few
	  users who will wish to say yes at this point - almost everyone will
	  wish to say no.  Selecting yes without understanding what is
	  going on could result in system crashes;

config OMAP_TPS6236X
       bool

config OMAP_ALLOW_OSWR
	bool  "Enable Open Switch Retention"
	depends on ARCH_OMAP4
	default n
	help
	  Select this option to enable OSWR support.
	  Which means the Logic of power domains can be lost now
	  unlike the CSWR wherein the logic is retained

config OMAP_FIQ_DEBUGGER
	bool "Enable the serial FIQ debugger on OMAP"
	default y
	select FIQ_DEBUGGER
	help
	  Enables the serial FIQ debugger on OMAP"

config OMAP4_PPA_CPU1_ONLINE_BUG
	bool "Enable Support for CPU1 ONLINE WA for OSWR/OFF"
	depends on ARCH_OMAP4
	depends on OMAP_ALLOW_OSWR
	default y
	help
	  If an non GP OMAP4 device is used and PPA revision is < v1.7.3,
	  the device does not perform the memory maintenance and TLB sync
	  operations required before releasing CPU1 to HLOS. This results
	  in crash while resuming from OFF mode.

	  Disable this option *ONLY IF* you meet the minimum PPA version
	  requirement.

	  If, on the other hand, you do not understand the change, leave the
	  default as enabled.

config OMAP_REBOOT_REASON
	depends on ARCH_OMAP4
	bool
	
config OMAP4_DPLL_CASCADING
	bool  "Enable DPLL Cascading for OMAP4"
	depends on ARCH_OMAP4
	depends on PM
	depends on HAS_EARLYSUSPEND
	default y
	help
	  Select this option to enable DPLL Cascading during Low power mp3
	  playback. It will enter DPLL cascade when :
                - Head set is inserted.
                - Display is Off.
                - No USB.

config OMAP4_ONLY_OMAP4430_DPLL_CASCADING
       bool  "Enable DPLL Cascading for OMAP4430 only"
       depends on OMAP4_DPLL_CASCADING
       default n
       help
         Enables DPLL Cascading only for OMAP4430.
	 Current DPLL cascading implementation is going to be used
	 only on OMAP4430, where it provides significant power savings.
	 Keeps DPLL cascading disabled for other OMAPs.


config OMAP_RAM_CONSOLE
        bool "Enable OMAP support for Android RAM console"
        depends on ANDROID_RAM_CONSOLE
        help
          Select this option to enable Android RAM console support on OMAP.
          This allows saving the kernel printk messages to a buffer in RAM, so
          that after a kernel panic they can be viewed in the next kernel
          invocation, by accessing /proc/last_kmsg
          NOTE: Board file needs to invoke relevant api to enable the support

config OMAP4_ARM_ERRATA_742230
	bool "Enables the workaround for ARM errata 742230 on GP devices"
	help
	  Enables the ARM errata 742230 on OMAP443x and OMAP446x (GP) devices.
	  This involves setting bit 4 of the CP15 diagnostic control register.
	  This is handled for HS devices in the PPA code and does not need to be
	  enabled."

config OMAP4_ARM_ERRATA_751472
	bool "Enables the workaround for ARM errata 751472 on GP devices"
	help
	  Enables the ARM errata 751472 on OMAP443x and OMAP446x (GP) devices.
	  This involves setting bit 11 of the CP15 diagnostic control register.
	  This is handled for HS devices in the PPA code and does not need to be
	  enabled."

config OMAP4_ARM_ERRATA_743622
	bool "Enabled the workaround for ARM errata 743622 on GP devices"
	help
	  Enables the workaround for ARM errata 743622 on OMAP4.
	  This involves setting bit 6 of the CP15 diagnostic control register.
	  This is handled for HS devices in the PPA code and does not need to be
	  enabled."

config OMAP4_HSOTG_ED_CORRECTION
	bool "OMAP 44XX HSOTG Eye diagram correction"
	depends on ARCH_OMAP4
	default y
	help
	  Select this option to overrive HSOTG PHY settings in
	  order to improve Eye Diagramm. On 4430 CPUs this should
	  improve Eye Diagram at least 8%.

endmenu

endif
```

## drivers/gpu/ion/Kconfig
```kconfig
menuconfig ION
	tristate "Ion Memory Manager"
	select GENERIC_ALLOCATOR
	select DMA_SHARED_BUFFER
	help
	  Chose this option to enable the ION Memory Manager.

config ION_TEGRA
	tristate "Ion for Tegra"
	depends on ARCH_TEGRA && ION
	help
	  Choose this option if you wish to use ion on an nVidia Tegra.

config ION_OMAP
	tristate "Ion for OMAP"
	depends on (ARCH_OMAP5 || ARCH_OMAP4) && ION && DRM_OMAP
	help
	  Choose this option if you wish to use ion on OMAP4/5.
	  This option shall be chosen if ion carveout is required
	  for OMAP4/5. The corresponding board file shall also have
	  the ion carveout implementation.

config ION_SYSTEM_HEAP_SYNCHRONOUS_FREE
	bool "Ion system heap using synchronous free"
	depends on ION
	help
	  Choose this option to make the system heap not use deferred free,
	  effectively making the free function synchronous.

config ION_SYSTEM_HEAP_POOL_ONLY
	bool "Ion system heap using pool memory only"
	depends on ION
	help
	  Choose this option to force all memory allocations to be pooled.
	  Currently, only uncached memory is pooled, while cached buffers are
	  allocated from the heap. Enabling this option will make cached
	  buffers to be pooled along with the uncached ones.
```

## drivers/net/wireless/bcmdhd/Kconfig
```kconfig
config BCMDHD
	tristate "Broadcom 4329/30 wireless cards support"
	depends on CFG80211
	depends on MMC
	---help---
	  This module adds support for wireless adapters based on
	  Broadcom 4329/30 chipset.

	  This driver uses the kernel's wireless extensions subsystem.

	  If you choose to build a module, it'll be called dhd. Say M if
	  unsure.

choice
	prompt "BCBDHD WLAN Chipset"
	depends on BCMDHD
	default BCMDHD_GENERIC
	help
	  Select BCM chipset this driver shall work with.
	  This setting will only affect the FW file name
	  loaded info BCM chip. No driver logic depends on it
	  Explicit selection helps track 

config BCMDHD_BCM4329
	bool "BCM4329"

config BCMDHD_BCM4330
	bool "BCM4330"

config BCMDHD_BCM43239
	bool "BCM43239"

config BCMDHD_BCM4324
	bool "BCM4324"

config BCMDHD_BCM43241
	bool "BCM43241"

config BCMDHD_GENERIC
	bool "Generic"

endchoice

config BCMDHD_FW_PATH
	depends on BCMDHD
	string "Firmware path"
	default "/system/vendor/firmware/fw_bcm4329.bin"  if BCMDHD_BCM4329
	default "/system/vendor/firmware/fw_bcm4330.bin"  if BCMDHD_BCM4330
	default "/system/vendor/firmware/fw_bcm43239.bin" if BCMDHD_BCM43239
	default "/system/vendor/firmware/fw_bcm4324.bin"  if BCMDHD_BCM4324
	default "/system/vendor/firmware/fw_bcm43241.bin" if BCMDHD_BCM43241
	default "/system/vendor/firmware/fw_bcmdhd.bin"   if BCMDHD_GENERIC
	---help---
	  Path to the firmware file.

config BCMDHD_NVRAM_PATH
	depends on BCMDHD
	string "NVRAM path"
	default "/system/etc/wifi/bcmdhd.cal"
	---help---
	  Path to the calibration file.

config BCMDHD_WEXT
	bool "Enable WEXT support"
	depends on BCMDHD && CFG80211 = n
	select WIRELESS_EXT
	select WEXT_PRIV
	help
	  Enables WEXT support

config DHD_USE_STATIC_BUF
	bool "Enable memory preallocation"
	depends on BCMDHD
	default n
	---help---
	  Use memory preallocated in platform

config DHD_USE_SCHED_SCAN
	bool "Use CFG80211 sched scan"
	depends on BCMDHD && CFG80211
	default n
	---help---
	  Use CFG80211 sched scan
```

## drivers/staging/trapz/Kconfig
```kconfig
config TRAPZ
	bool "Tracing and Profiling for Zpeed"
	default n
	help
		enable
		TRAPZ tool
		- Tracing and Profilling
		for Zpeed

config TRAPZ_TP
	bool "Globally enable trapz trace points in kernel"
	default n
	depends on TRAPZ
	help
		This enables trapz tracepoints. If this is disabled
		and CONFIG_TRAPZ is enabled, userspace trapz tracing
		is still functional. TRAPZ (framework config) needs
		to be enabled separately.

config TRAPZ_TRIGGER
	bool "Include ability to trigger events based on latency"
	default n
	depends on TRAPZ
	help
		This feature issues uevents if a trigger is fired.  The uevents can then
		be trapped in user space to react

config TRAPZ_PVA
	bool "Additional tracing for PVA, may cause extra system load"
	default n
	depends on TRAPZ
```

## security/smc/Kconfig
```kconfig
config TF_ZEBRA
	bool

config SECURITY_MIDDLEWARE_COMPONENT
	tristate "Enable SMC Driver"
	depends on ARCH_OMAP4 || ARCH_OMAP5
	select TF_ZEBRA
	select CRYPTO_SHA1
	help
	  This option adds kernel support for communication with the SMC
	  Protected Application.

	  If you are unsure how to answer this question, answer N.

config SMC_KERNEL_CRYPTO
	bool "Register SMC into kernel crypto subsytem"
	depends on SECURITY_MIDDLEWARE_COMPONENT
	help
	  This option enables crypto subsystem to use SMC and OMAP hardware
	  accelerators.

	  If you are unsure how to answer this question, answer Y.

config SECURE_TRACE
	bool "Enable SMC secure traces"
	depends on SECURITY_MIDDLEWARE_COMPONENT
	default y
	help
	  This option enables traces from the SMC Protected Application to be
	  displayed in kernel logs.

	  If you are unsure how to answer this question, answer Y.

config TF_DRIVER_DEBUG_SUPPORT
	bool "Debug support"
	depends on SECURITY_MIDDLEWARE_COMPONENT
	help
	  This option enables debug traces in the driver.

	  If you are unsure how to answer this question, answer N.

config TF_DRIVER_CRYPTO_FIPS
	bool "FIPS compliance support"
	depends on SMC_KERNEL_CRYPTO && MODULE_EXTRA_COPY
	help
          This option enables features for FIPS certification of the SMC
          cryptographic driver: built-in test vectors for POST, and a
          device for user space programs to submit more test vectors.

          If you are unsure how to answer this question, answer N.

config TF_DRIVER_FAULT_INJECTION
	bool "Fault injection support"
	depends on TF_DRIVER_CRYPTO_FIPS
	help
	  This option allows forcing cryptographic operations in the SMC
	  driver to fail.

	  If you are unsure how to answer this question, answer Y.

config TF_CRYPTO_RNG
	tristate "Use OMAP HW RNG"
	depends on m
	select SECURITY_MIDDLEWARE_COMPONENT
	help
	  This option enables OMAP HW RNG support.

	  If you are unsure how to answer this question, answer N.

choice
	prompt "Select DRM driver"
	default DRM_WIDEVINE

config DRM_PLAYREADY
	bool "Playready DRM"

config DRM_WIDEVINE
	bool "Widevine DRM"

endchoice
```
