## arch/arm/configs/android_acclaim_defconfig
```kconfig
CONFIG_MACH_OMAP_BN=y
CONFIG_MACH_OMAP_ACCLAIM=y
CONFIG_CMDLINE="mem=1G vmalloc=496M androidboot.hardware=acclaim androidboot.selinux=permissive omapfb.fb_opt=-1,-1,-1,1,1024,600"
# CONFIG_CMDLINE_EXTEND is not set
CONFIG_CMDLINE_FORCE=y
CONFIG_BT_HCIUART=m
CONFIG_MAC80211_HAS_RC=y
CONFIG_MAC80211_RC_MINSTREL=y
CONFIG_MAC80211_RC_MINSTREL_HT=y
CONFIG_MAC80211_RC_DEFAULT_MINSTREL=y
CONFIG_MAC80211_RC_DEFAULT="minstrel_ht"
CONFIG_MAC80211_LEDS=y
CONFIG_MAC80211_DEBUGFS=y
# CONFIG_NFC_DEVICES is not set
# CONFIG_CAIF is not set
# CONFIG_CAIF_HSI_OMAP is not set
CONFIG_BLK_DEV_UB=y
CONFIG_INPUT_MOUSEDEV_SCREEN_X=1024
CONFIG_INPUT_MOUSEDEV_SCREEN_Y=600
CONFIG_TOUCHSCREEN_FT5X06=y
CONFIG_INPUT_KXTF9=y
CONFIG_BATTERY_MAX17042=y
CONFIG_CHARGER_MAX8903=y
CONFIG_OMAP2_DSS_SLEEP_AFTER_VENC_RESET=y
CONFIG_PANEL_BOXER=y
CONFIG_LEDS_OMAP_PWM=y
CONFIG_OMAP_PWM_LED_TYPE_DMTIMER=y
CONFIG_USB_SERIAL=y
CONFIG_USB_GADGET_VBUS_DRAW=500
CONFIG_MMC_PARANOID_SD_INIT=y
CONFIG_FB_EARLYSUSPEND=n
# CONFIG_SND_OMAP_SOC_OMAP_HDMI is not set
# CONFIG_SND_OMAP_SOC_OMAP_ABE_TWL6040 is not set
CONFIG_SND_OMAP_SOC_OMAP4_PANDA_AIC31XX=y
CONFIG_SND_SOC_TLV320AIC31XX=y
```

## arch/arm/configs/android_hummingbird_defconfig
```kconfig
# CONFIG_KERNEL_GZIP is not set
CONFIG_KERNEL_XZ=y
CONFIG_RD_XZ=y
CONFIG_CC_OPTIMIZE_FOR_SIZE=y
CONFIG_MACH_OMAP_BN=y
CONFIG_MACH_OMAP_HUMMINGBIRD=y
CONFIG_USE_AMAZON_DUCATI=y
CONFIG_CMDLINE="androidboot.serialno=3024440170004302 boot.fb=b2200000 vmalloc=496M androidboot.hardware=hummingbird omapfb.fb_opt=-1,-1,-1,1,900,1440 androidboot.selinux=permissive"
# CONFIG_CMDLINE_EXTEND is not set
CONFIG_CMDLINE_FORCE=y
CONFIG_BT_HCIUART=m
CONFIG_MAC80211_HAS_RC=y
CONFIG_MAC80211_RC_MINSTREL=y
CONFIG_MAC80211_RC_MINSTREL_HT=y
CONFIG_MAC80211_RC_DEFAULT_MINSTREL=y
CONFIG_MAC80211_RC_DEFAULT="minstrel_ht"
CONFIG_MAC80211_LEDS=y
CONFIG_MAC80211_DEBUGFS=y
# CONFIG_NFC_DEVICES is not set
CONFIG_BLK_DEV_UB=y
CONFIG_INPUT_MOUSEDEV_SCREEN_X=900
CONFIG_INPUT_MOUSEDEV_SCREEN_Y=1440
CONFIG_TOUCHSCREEN_FT5X06=y
CONFIG_INPUT_KXTF9=y
CONFIG_INPUT_TWL6040_HSKEYS=y
CONFIG_CHARGER_BQ2419x=y
CONFIG_BATTERY_BQ27x00=y
CONFIG_BATTERY_BQ27X00_I2C=y
CONFIG_FB_OMAP_BOOTLOADER_INIT=y
CONFIG_PANEL_AUO=y
CONFIG_PANEL_HYDIS=y
CONFIG_PANEL_ORISE=y
CONFIG_PANEL_NOVATEK=y
CONFIG_BACKLIGHT_LP855X=y
CONFIG_USB_SERIAL=y
CONFIG_MMC_PARANOID_SD_INIT=y
CONFIG_FB_EARLYSUSPEND=n
```

## arch/arm/configs/android_jem_defconfig
```kconfig
# CONFIG_KERNEL_GZIP is not set
CONFIG_KERNEL_XZ=y
CONFIG_RD_XZ=y
CONFIG_CC_OPTIMIZE_FOR_SIZE=y
CONFIG_MACH_OMAP4_BOWSER=y
CONFIG_MACH_OMAP4_BOWSER_SUBTYPE_JEM=y
CONFIG_USE_AMAZON_DUCATI=y
CONFIG_CMDLINE="mem=1G console=null vmalloc=496M rootdelay=2 androidboot.console=ttyO2 androidboot.hardware=bowser omapfb.fb_opt=-1,-1,-1,1,1920,1200 androidboot.selinux=permissive"
# CONFIG_CMDLINE_EXTEND is not set
CONFIG_CMDLINE_FORCE=y
# CONFIG_BT_WILINK is not set
CONFIG_CFG80211=y
CONFIG_MAC80211=y
# CONFIG_NFC_DEVICES is not set
# CONFIG_TI_ST is not set
CONFIG_BCMDHD=m
CONFIG_BCMDHD_FW_PATH="/system/vendor/firmware/fw_bcmdhd.bin"
CONFIG_BCMDHD_NVRAM_PATH="/system/etc/wifi/bcmdhd.cal"
# CONFIG_WL12XX_MENU is not set
CONFIG_INPUT_POLLDEV=y
CONFIG_INPUT_MOUSEDEV_SCREEN_X=1920
CONFIG_INPUT_MOUSEDEV_SCREEN_Y=1200
CONFIG_TOUCHSCREEN_CYPRESS_TTSP=y
CONFIG_TOUCHSCREEN_CYPRESS_TTSP_SWAP_XY=y
CONFIG_TOUCHSCREEN_CYPRESS_TTSP_FLIP_X=y
# CONFIG_TOUCHSCREEN_CYPRESS_TTSP_FLIP_Y is not set
CONFIG_INPUT_KEYCHORD=y
CONFIG_INPUT_GPIO=y
CONFIG_INPUT_CMA3000=y
CONFIG_INPUT_CMA3000_I2C=y
CONFIG_INPUT_BH1780=y
CONFIG_INPUT_BMP085=y
CONFIG_INPUT_HMC5843=y
CONFIG_INPUT_BU52061_HALLSENSOR=y
CONFIG_GPIO_TWL4030=y
CONFIG_BATTERY_BQ27541=y
CONFIG_CHARGER_SMB347=y
# CONFIG_TWL6040_CORE is not set
# CONFIG_RADIO_ADAPTERS is not set
CONFIG_FB_OMAP_BOOTLOADER_INIT=y
# CONFIG_OMAP2_DSS_DPI is not set
CONFIG_PANEL_NT71391_HYDIS=y
CONFIG_BACKLIGHT_BOWSER=y
# CONFIG_SND_OMAP_SOC_OMAP_ABE_TWL6040 is not set
CONFIG_SND_OMAP_SOC_BOWSER_WOLFSON=y
CONFIG_SND_OMAP_SOC_BOWSER=y
CONFIG_SND_SOC_WM8962=y
CONFIG_USB_SERIAL=y
CONFIG_USB_SERIAL_CONSOLE=y
CONFIG_USB_EZUSB=y
CONFIG_USB_SERIAL_GENERIC=y
CONFIG_USB_SERIAL_QUALCOMM=y
CONFIG_USB_SERIAL_WWAN=y
CONFIG_USB_GADGET_VBUS_DRAW=500
CONFIG_TWL6030_USB_DISABLE_VBUS_TYPE_DETECTION=y
# CONFIG_MMC_EMBEDDED_SDIO is not set
CONFIG_MMC_SAMSUNG_SMART=y
CONFIG_IIO=y
CONFIG_IIO_BUFFER=y
CONFIG_IIO_SW_RING=y
CONFIG_IIO_KFIFO_BUF=y
CONFIG_IIO_TRIGGER=y
CONFIG_IIO_CONSUMERS_PER_TRIGGER=2
CONFIG_INV_MPU_IIO=y
# CONFIG_INV_IIO_MPU3050_ACCEL_SLAVE_BMA250 is not set
CONFIG_CASE_TEMP_GOVERNOR=y
CONFIG_TMP103_SENSOR=y
# CONFIG_THERMISTOR_SENSOR is not set
CONFIG_OMAP4_IPU_CMA_SIZE=0x3A00000
CONFIG_XZ_DEC=y
CONFIG_XZ_DEC_X86=y
CONFIG_XZ_DEC_POWERPC=y
CONFIG_XZ_DEC_IA64=y
CONFIG_XZ_DEC_ARM=y
CONFIG_XZ_DEC_ARMTHUMB=y
CONFIG_XZ_DEC_SPARC=y
CONFIG_XZ_DEC_BCJ=y
# CONFIG_XZ_DEC_TEST is not set
CONFIG_DECOMPRESS_XZ=y

CONFIG_SND_DEBUG=y
CONFIG_DEBUG_BUGVERBOSE=y
```
